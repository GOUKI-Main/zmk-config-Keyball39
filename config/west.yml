## config/west.yml
```yaml
manifest:
  remotes:
    - name: zmkfirmware
      url-base: https://github.com/zmkfirmware
    - name: kumamuk-git
      url-base: https://github.com/kumamuk-git
    - name: KOHSUK
      url-base: https://github.com/KOHSUK
  projects:
    - name: zmk
      remote: zmkfirmware
      revision: v0.2
      import: app/west.yml
    # PMW3360 ドライバー（現在使用中）
    - name: zmk-pmw3360-driver
      remote: KOHSUK
      revision: pmw3360
    # PMW3610 ドライバー（将来の移行用 - 現在は使用していません）
    # 移行時はwest.ymlでこちらを有効化し、overlay内のcompatibleとconf設定を変更してください
    # - name: zmk-pmw3610-driver
    #   remote: kumamuk-git
    #   revision: main
  self:
    path: config
```
